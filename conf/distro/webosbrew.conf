## conf/layer.conf
```bitbake
# We have a conf and classes directory, add to BBPATH
BBPATH .= ":${LAYERDIR}"

# We have recipes-* directories, add to BBFILES
BBFILES += "${LAYERDIR}/recipes-*/*/*.bb \
            ${LAYERDIR}/recipes-*/*/*.bbappend"

BBFILE_COLLECTIONS += "meta-webosbrew"
BBFILE_PATTERN_meta-webosbrew = "^${LAYERDIR}/"
BBFILE_PRIORITY_meta-webosbrew = "6"

LAYERDEPENDS_meta-webosbrew = "core"
LAYERSERIES_COMPAT_meta-webosbrew = "honister kirkstone"

SDKIMAGE_FEATURES .= "staticdev-pkgs"
```
